/*
* The ICC Software License, Version 0.2
*
*
* Copyright (c) 2003-2012 The International Color Consortium. All rights
* reserved.
*
* Redistribution and use in source and binary forms, with or without
* modification, are permitted provided that the following conditions
* are met:
*
* 1. Redistributions of source code must retain the above copyright
*    notice, this list of conditions and the following disclaimer.
*
* 2. Redistributions in binary form must reproduce the above copyright
*    notice, this list of conditions and the following disclaimer in
*    the documentation and/or other materials provided with the
*    distribution.
*
* 3. In the absence of prior written permission, the names "ICC" and "The
*    International Color Consortium" must not be used to imply that the
*    ICC organization endorses or promotes products derived from this
*    software.
*
*
* THIS SOFTWARE IS PROVIDED ``AS IS'' AND ANY EXPRESSED OR IMPLIED
* WARRANTIES, INCLUDING, BUT NOT LIMITED TO, THE IMPLIED WARRANTIES
* OF MERCHANTABILITY AND FITNESS FOR A PARTICULAR PURPOSE ARE
* DISCLAIMED.  IN NO EVENT SHALL THE INTERNATIONAL COLOR CONSORTIUM OR
* ITS CONTRIBUTING MEMBERS BE LIABLE FOR ANY DIRECT, INDIRECT, INCIDENTAL,
* SPECIAL, EXEMPLARY, OR CONSEQUENTIAL DAMAGES (INCLUDING, BUT NOT
* LIMITED TO, PROCUREMENT OF SUBSTITUTE GOODS OR SERVICES; LOSS OF
* USE, DATA, OR PROFITS; OR BUSINESS INTERRUPTION) HOWEVER CAUSED AND
* ON ANY THEORY OF LIABILITY, WHETHER IN CONTRACT, STRICT LIABILITY,
* OR TORT (INCLUDING NEGLIGENCE OR OTHERWISE) ARISING IN ANY WAY OUT
* OF THE USE OF THIS SOFTWARE, EVEN IF ADVISED OF THE POSSIBILITY OF
* SUCH DAMAGE.
* ====================================================================
*
* This software consists of voluntary contributions made by many
* individuals on behalf of the The International Color Consortium.
*
*
* Membership in the ICC is encouraged when this software is used for
* commercial purposes.
*
*
* For more information on The International Color Consortium, please
* see <http://www.color.org/>.
*
*
*/

/*
    File:       pcs-adjust-placement.cpp

    Contains:   Characterization tests for PCS adjustment placement.

    A PCS adjustment (absolute media-white scaling, the v2-perceptual black
    point shift) is applied either by CIccPcsXform or inside CIccXform::Apply,
    depending on where the transform sits in the chain. This file pins what the
    adjustment *does*, so that moving *where* it happens is provably behaviour
    preserving.

    Tolerance: assertions use 1e-5 relative. The adjustments under test are
    ~3.5e-3 (v2 perceptual) or larger (absolute); re-associating the same affine
    math into CIccPcsSteps moves results by ~1e-7. Bit-equality is the wrong
    oracle and would fail on correct code.
*/

#include "IccArrayBasic.h"
#include "IccCmm.h"
#include "IccDefs.h"
#include "IccProfile.h"
#include "IccTag.h"
#include "IccTagBasic.h"
#include "IccTagLut.h"

#include <cmath>
#include <cstdio>

static int g_failures = 0;

static void check(bool cond, const char *msg)
{
  if (cond) {
    std::printf("ok:   %s\n", msg);
  }
  else {
    std::printf("FAIL: %s\n", msg);
    ++g_failures;
  }
}

// Relative comparison with an absolute floor, so values near zero do not
// demand impossible precision.
static bool closeRel(double got, double want, double tol)
{
  const double diff = std::fabs(got - want);
  const double scale = std::fabs(want) > 1.0 ? std::fabs(want) : 1.0;
  return diff / scale <= tol;
}

static const double kTol = 1e-5;

// --- fixtures -------------------------------------------------------------
// Built in memory rather than read from Testing/*.icc: Testing/**/*.icc is
// gitignored and generated by CreateAllProfiles.sh, so a tracked fixture is not
// available on a fresh clone.

static void attachRequiredTags(CIccProfile &profile, const char *desc)
{
  CIccTagTextDescription *pDesc = new CIccTagTextDescription();
  pDesc->SetText(desc);
  profile.AttachTag(icSigProfileDescriptionTag, pDesc);

  CIccTagText *pCprt = new CIccTagText();
  pCprt->SetText("Copyright (C) 2026 The International Color Consortium");
  profile.AttachTag(icSigCopyrightTag, pCprt);

  // Deliberately NOT the D50 illuminant. The absolute-intent adjustment is
  // driven by (mediaWhite != illuminant); a D50 media white would make the
  // absolute cases silently no-ops and the test would prove nothing.
  CIccTagXYZ *pWtpt = new CIccTagXYZ(1);
  (*pWtpt)[0].X = icDtoF((icFloatNumber)0.9000);
  (*pWtpt)[0].Y = icDtoF((icFloatNumber)0.9500);
  (*pWtpt)[0].Z = icDtoF((icFloatNumber)0.7500);
  profile.AttachTag(icSigMediaWhitePointTag, pWtpt);
}

// A smooth CMYK -> Lab cell. Values are PCS-encoded 0..1.
static void cmykToLabCell(const double *in, icFloatNumber *out)
{
  const double k = in[3];
  const double lum = (1.0 - k) * (1.0 - 0.30 * in[0] - 0.20 * in[1] - 0.10 * in[2]);
  out[0] = (icFloatNumber)(lum < 0.0 ? 0.0 : lum);            // L* 0..1
  out[1] = (icFloatNumber)(0.5 + 0.25 * (in[0] - in[1]));     // a* offset-encoded
  out[2] = (icFloatNumber)(0.5 + 0.25 * (in[1] - in[2]));     // b* offset-encoded
}

// A rough inverse of the above. It does not have to invert exactly -- every
// assertion in this file compares two chains built from the *same* CLUTs, so
// LUT round-trip error cancels and only the PCS adjustment can differ.
static void labToCmykCell(const double *in, icFloatNumber *out)
{
  const double da = in[1] - 0.5;
  const double db = in[2] - 0.5;
  double v[4];
  v[0] = 0.5 + 2.0 * da;
  v[1] = 0.5 - 2.0 * da + 2.0 * db;
  v[2] = 0.5 - 2.0 * db;
  v[3] = 1.0 - in[0];
  for (int i = 0; i < 4; i++) {
    if (v[i] < 0.0) v[i] = 0.0;
    if (v[i] > 1.0) v[i] = 1.0;
    out[i] = (icFloatNumber)v[i];
  }
}

// Build an nIn-in / nOut-out LUT tag with identity curves either side of a CLUT
// filled by pFill.
//
// 'mft2' keeps the matrix on the input side so B is the input curve array,
// while 'mAB ' clears m_bInputMatrix so A is. Filling the wrong one writes
// nIn pointers into an nOut-pointer array.
template <class TTag>
static TTag *buildLut(icUInt8Number nGrid,
                      icUInt8Number nIn, icUInt8Number nOut,
                      icColorSpaceSignature srcSpace, icColorSpaceSignature dstSpace,
                      void (*pFill)(const double *, icFloatNumber *))
{
  TTag *pTag = new TTag();
  pTag->Init(nIn, nOut);
  pTag->SetColorSpaces(srcSpace, dstSpace);

  const bool bInputIsB = pTag->IsInputB();

  LPIccCurve *pIn = bInputIsB ? pTag->NewCurvesB() : pTag->NewCurvesA();
  for (int i = 0; i < (int)nIn; i++) {
    CIccTagCurve *pCurve = (CIccTagCurve*)CIccTag::Create(icSigCurveType);
    pCurve->SetSize(2);
    (*pCurve)[0] = 0.0f;
    (*pCurve)[1] = 1.0f;
    pIn[i] = pCurve;
  }

  CIccCLUT *pCLUT = new CIccCLUT(nIn, (icUInt16Number)nOut);
  if (!pCLUT->Init(nGrid)) {
    delete pCLUT;
    delete pTag;
    return NULL;
  }
  icFloatNumber *pData = pCLUT->GetData(0);
  for (icUInt32Number p = 0; p < pCLUT->NumPoints(); p++) {
    double in[4] = { 0.0, 0.0, 0.0, 0.0 };
    icUInt32Number rem = p;
    for (int ax = (int)nIn - 1; ax >= 0; ax--) {   // axis 0 varies slowest
      in[ax] = (double)(rem % nGrid) / (double)(nGrid - 1);
      rem /= nGrid;
    }
    pFill(in, &pData[(size_t)p * nOut]);
  }
  pTag->SetCLUT(pCLUT);

  LPIccCurve *pOut = bInputIsB ? pTag->NewCurvesA() : pTag->NewCurvesB();
  for (int i = 0; i < (int)nOut; i++) {
    CIccTagCurve *pCurve = (CIccTagCurve*)CIccTag::Create(icSigCurveType);
    pCurve->SetSize(2);
    (*pCurve)[0] = 0.0f;
    (*pCurve)[1] = 1.0f;
    pOut[i] = pCurve;
  }
  return pTag;
}

// AToB0/AToB1 and BToA0/BToA1 get identical CLUT content on purpose. A
// perceptual chain and a relative chain then differ by the PCS adjustment and
// by nothing else, which is what makes them comparable.
//
// Both directions are attached because a CMYK -> Lab -> CMYK chain needs BToA
// for its second xform, and a Lab -> CMYK chain needs it for its only one.
template <class TAtoB, class TBtoA>
static void attachLutPair(CIccProfile &p)
{
  p.AttachTag(icSigAToB0Tag, buildLut<TAtoB>(5, 4, 3, icSigCmykData, icSigLabData, cmykToLabCell));
  p.AttachTag(icSigAToB1Tag, buildLut<TAtoB>(5, 4, 3, icSigCmykData, icSigLabData, cmykToLabCell));
  p.AttachTag(icSigBToA0Tag, buildLut<TBtoA>(9, 3, 4, icSigLabData, icSigCmykData, labToCmykCell));
  p.AttachTag(icSigBToA1Tag, buildLut<TBtoA>(9, 3, 4, icSigLabData, icSigCmykData, labToCmykCell));
}

// v2 output CMYK, Lab PCS. IsVersion2() is what turns on the perceptual
// black-point adjustment, so this is the fixture for the perceptual cases.
void buildV2CmykOutputProfile(CIccProfile &p)
{
  p.InitHeader();
  p.m_Header.version     = icVersionNumberV2_1;
  p.m_Header.deviceClass = icSigOutputClass;
  p.m_Header.colorSpace  = icSigCmykData;
  p.m_Header.pcs         = icSigLabData;
  attachLutPair<CIccTagLut16, CIccTagLut16>(p);
  attachRequiredTags(p, "pcs adjust placement v2 fixture");
}

// v4 output CMYK, Lab PCS. HasPerceptualHandling() is true here, so perceptual
// gets no adjustment and only absolute intent does -- the control.
void buildV4CmykOutputProfile(CIccProfile &p)
{
  p.InitHeader();
  p.m_Header.version     = icVersionNumberV4_3;
  p.m_Header.deviceClass = icSigOutputClass;
  p.m_Header.colorSpace  = icSigCmykData;
  p.m_Header.pcs         = icSigLabData;
  attachLutPair<CIccTagLutAtoB, CIccTagLutBtoA>(p);
  attachRequiredTags(p, "pcs adjust placement v4 fixture");
}

// --- cases ----------------------------------------------------------------

// The size of the adjustment is the whole oracle: if it is smaller than the
// tolerance band, every other assertion in this file is vacuous.
static void adjustmentIsLargerThanTheToleranceBand()
{
  const double perceptualScale = 1.0 - icPerceptualRefBlackY / icPerceptualRefWhiteY;
  check(std::fabs(1.0 - perceptualScale) > 100.0 * kTol,
        "v2 perceptual adjustment is at least 100x the 1e-5 tolerance band");
}

// Trailing PCS edge: CMYK -> Lab, one profile. Only ever called with an
// intent that is expected to move the PCS result relative to the unadjusted
// relative-colorimetric reference -- see relativeIntentTakesNoAdjustment()
// below for the case where no movement is expected, which needs a structural
// check instead of a numeric one (a numeric "did not move" comparison against
// a reference built from the *same* intent is not falsifiable: see Finding 1).
static void trailingEdgeAdjustmentApplies(icRenderingIntent nIntent,
                                          const char *label)
{
  CIccProfile v2;
  buildV2CmykOutputProfile(v2);

  icFloatNumber cmyk[4] = { 0.1f, 0.2f, 0.3f, 0.4f };
  icFloatNumber withIntent[3] = { 0 }, relative[3] = { 0 };

  {
    CIccCmm cmm(icSigCmykData, icSigLabData, true);
    check(cmm.AddXform(v2, nIntent) == icCmmStatOk, "trailing: AddXform");
    check(cmm.Begin() == icCmmStatOk, "trailing: Begin");
    check(cmm.Apply(withIntent, cmyk) == icCmmStatOk, "trailing: Apply");
  }
  {
    // icRelativeColorimetric on a v2 profile takes no adjustment, so it is the
    // unadjusted reference the adjusted result must differ from.
    CIccCmm cmm(icSigCmykData, icSigLabData, true);
    check(cmm.AddXform(v2, icRelativeColorimetric) == icCmmStatOk, "trailing: ref AddXform");
    check(cmm.Begin() == icCmmStatOk, "trailing: ref Begin");
    check(cmm.Apply(relative, cmyk) == icCmmStatOk, "trailing: ref Apply");
  }

  const bool moved = !closeRel(withIntent[0], relative[0], kTol);
  check(moved, label);
}

// Negative control for the whole file. The three numeric cases above all
// compare an adjusted result against a relative-intent reference and assume
// that reference carries no adjustment; this proves it structurally instead
// of assuming it, by asking the xform itself rather than diffing two applies.
//
// A numeric "relative result equals a second relative result" comparison
// would be unconditionally true regardless of library behaviour -- including
// if the library erroneously started adjusting relative intent, since the
// same adjustment would land identically on both sides of that comparison
// and cancel out of the diff. NeedAdjustPCS() has no such blind spot: it
// fails the moment relative intent sets m_bAdjustPCS for any reason.
static void relativeIntentTakesNoAdjustment()
{
  CIccProfile *pProfile = new CIccProfile();
  buildV2CmykOutputProfile(*pProfile);

  // CIccXform::Create takes ownership of the profile it is given.
  CIccXform *pXform = CIccXform::Create(pProfile, true, icRelativeColorimetric, icInterpTetrahedral);
  check(pXform != NULL, "relative: xform created");
  if (!pXform) return;

  check(pXform->Begin() == icCmmStatOk, "relative: Begin");
  check(!pXform->NeedAdjustPCS(),
        "trailing edge: relative intent takes no PCS adjustment (structural)");

  delete pXform;
}

// Interior PCS connection: CMYK -> Lab -> CMYK, two profiles, same intent both
// ways. The two adjustments are exact inverses and adjacent in the PCS, so the
// round trip must equal the same round trip run with no adjustment at all.
static void interiorAdjustmentsCancel()
{
  CIccProfile v2a, v2b, v2c, v2d;
  buildV2CmykOutputProfile(v2a);
  buildV2CmykOutputProfile(v2b);
  buildV2CmykOutputProfile(v2c);
  buildV2CmykOutputProfile(v2d);

  icFloatNumber cmyk[4] = { 0.1f, 0.2f, 0.3f, 0.4f };
  icFloatNumber perceptual[4] = { 0 }, relative[4] = { 0 };

  {
    CIccCmm cmm(icSigCmykData, icSigCmykData, true);
    check(cmm.AddXform(v2a, icPerceptual) == icCmmStatOk, "interior: AddXform 1");
    check(cmm.AddXform(v2b, icPerceptual) == icCmmStatOk, "interior: AddXform 2");
    check(cmm.Begin() == icCmmStatOk, "interior: Begin");
    check(cmm.Apply(perceptual, cmyk) == icCmmStatOk, "interior: Apply");
  }
  {
    CIccCmm cmm(icSigCmykData, icSigCmykData, true);
    check(cmm.AddXform(v2c, icRelativeColorimetric) == icCmmStatOk, "interior: ref AddXform 1");
    check(cmm.AddXform(v2d, icRelativeColorimetric) == icCmmStatOk, "interior: ref AddXform 2");
    check(cmm.Begin() == icCmmStatOk, "interior: ref Begin");
    check(cmm.Apply(relative, cmyk) == icCmmStatOk, "interior: ref Apply");
  }

  // Both chains use AToB0/BToA0 vs AToB1/BToA1 respectively, but this fixture
  // gives both intents the same CLUT, so the only possible difference is the
  // adjustment -- and it must cancel.
  bool same = true;
  for (int i = 0; i < 4; i++)
    same = same && closeRel(perceptual[i], relative[i], kTol);
  check(same,
        "interior: perceptual round trip equals relative round trip "
        "(the two PCS adjustments cancel)");
}

// Connect() reports the cancellation directly: with the same profile and intent
// on both sides, every pushed step folds away and Connect returns identity.
static void connectReportsIdentityWhenAdjustmentsCancel()
{
  CIccProfile *pIn  = new CIccProfile();
  CIccProfile *pOut = new CIccProfile();
  buildV2CmykOutputProfile(*pIn);
  buildV2CmykOutputProfile(*pOut);

  // CIccXform::Create takes ownership of the profile it is given.
  CIccXform *pFrom = CIccXform::Create(pIn,  true,  icPerceptual, icInterpTetrahedral);
  CIccXform *pTo   = CIccXform::Create(pOut, false, icPerceptual, icInterpTetrahedral);
  check(pFrom != NULL && pTo != NULL, "connect: xforms created");
  if (!pFrom || !pTo) { delete pFrom; delete pTo; return; }

  pFrom->Begin();
  pTo->Begin();

  // This is what CheckPCSConnections() does before calling Connect().
  pFrom->SetDstPCSConversion(false);
  pTo->SetSrcPCSConversion(false);

  CIccPcsXform pcs;
  const icStatusCMM rv = pcs.Connect(pFrom, pTo);
  check(rv == icCmmStatIdentityXform,
        "connect: matched perceptual adjustments fold to icCmmStatIdentityXform");

  delete pFrom;
  delete pTo;
}

// The predicates must reproduce exactly what CheckSrcAbs/CheckDstAbs test:
// source side only for output xforms, destination side only for input xforms.
// An abstract-class xform has PCS on both sides but must still adjust on
// exactly one, and this is the assertion that pins it.
static void perSideAdjustPredicatesFollowDirection()
{
  CIccProfile *pIn  = new CIccProfile();
  CIccProfile *pOut = new CIccProfile();
  buildV2CmykOutputProfile(*pIn);
  buildV2CmykOutputProfile(*pOut);

  CIccXform *pInput  = CIccXform::Create(pIn,  true,  icPerceptual, icInterpTetrahedral);
  CIccXform *pOutput = CIccXform::Create(pOut, false, icPerceptual, icInterpTetrahedral);
  check(pInput != NULL && pOutput != NULL, "predicates: xforms created");
  if (!pInput || !pOutput) { delete pInput; delete pOutput; return; }

  pInput->Begin();
  pOutput->Begin();

  check(pInput->NeedAdjustPCS(), "predicates: v2 perceptual input xform needs an adjust");
  check(pOutput->NeedAdjustPCS(), "predicates: v2 perceptual output xform needs an adjust");

  check(!pInput->NeedsSrcPcsAdjust(),
        "predicates: an input xform never adjusts on its source side");
  check(pInput->NeedsDstPcsAdjust(),
        "predicates: an input xform adjusts on its destination side");

  check(pOutput->NeedsSrcPcsAdjust(),
        "predicates: an output xform adjusts on its source side");
  check(!pOutput->NeedsDstPcsAdjust(),
        "predicates: an output xform never adjusts on its destination side");

  delete pInput;
  delete pOutput;
}

// A v4 profile has HasPerceptualHandling(), so perceptual sets no adjustment at
// all. Guards against a predicate that returns true unconditionally.
static void perSideAdjustPredicatesAreOffWhenNothingToAdjust()
{
  CIccProfile *pOut = new CIccProfile();
  buildV4CmykOutputProfile(*pOut);

  CIccXform *pOutput = CIccXform::Create(pOut, false, icPerceptual, icInterpTetrahedral);
  check(pOutput != NULL, "predicates: v4 xform created");
  if (!pOutput) return;
  pOutput->Begin();

  check(!pOutput->NeedAdjustPCS(), "predicates: v4 perceptual needs no adjust");
  check(!pOutput->NeedsSrcPcsAdjust(), "predicates: v4 perceptual source side off");
  check(!pOutput->NeedsDstPcsAdjust(), "predicates: v4 perceptual destination side off");

  delete pOutput;
}

// CIccXformNamedColor's overrides narrow the base formula by IsSrcPCS()/
// IsDestPCS(): a named-colour xform whose relevant side isn't actually the
// profile's PCS must answer no even when the base m_bAdjustPCS/m_bInput
// combination alone would answer yes. This pins that the override actually
// changes the answer, not just that it compiles and links.
static void namedColorAdjustPredicatesRequireAnActualPcsSide()
{
  CIccProfile *pOutProfile = new CIccProfile();
  buildV2CmykOutputProfile(*pOutProfile);
  pOutProfile->AttachTag(icSigNamedColor2Tag, new CIccTagNamedColor2(1, 4));

  CIccProfile *pInProfile = new CIccProfile();
  buildV2CmykOutputProfile(*pInProfile);
  pInProfile->AttachTag(icSigNamedColor2Tag, new CIccTagNamedColor2(1, 4));

  CIccXform *pOutXform = CIccXform::Create(pOutProfile, /*bInput=*/false, icPerceptual,
                                            icInterpTetrahedral, NULL, icXformLutNamedColor);
  CIccXform *pInXform  = CIccXform::Create(pInProfile,  /*bInput=*/true,  icPerceptual,
                                            icInterpTetrahedral, NULL, icXformLutNamedColor);
  check(pOutXform != NULL && pInXform != NULL, "named color: xforms created");
  if (!pOutXform || !pInXform) { delete pOutXform; delete pInXform; return; }

  // Neither side under test is set to the profile's Lab PCS here -- unlike a
  // real named-colour lookup, which always has one side be the PCS. That is
  // exactly the condition the overrides add on top of the base predicates.
  // SetDestSpace() rejects a destination equal to the source, so the other
  // side is set to icSigNamedData (also not the PCS, and a legal pairing).
  ((CIccXformNamedColor*)pOutXform)->SetSrcSpace(icSigCmykData);
  ((CIccXformNamedColor*)pOutXform)->SetDestSpace(icSigNamedData);
  ((CIccXformNamedColor*)pInXform)->SetSrcSpace(icSigNamedData);
  ((CIccXformNamedColor*)pInXform)->SetDestSpace(icSigCmykData);

  check(pOutXform->Begin() == icCmmStatOk, "named color: output-side Begin");
  check(pInXform->Begin() == icCmmStatOk, "named color: input-side Begin");

  check(pOutXform->NeedAdjustPCS(), "named color: v2 perceptual output needs an adjust (base)");
  check(pInXform->NeedAdjustPCS(), "named color: v2 perceptual input needs an adjust (base)");

  // CIccXform::NeedsSrcPcsAdjust() alone (m_bAdjustPCS && !m_bInput) would
  // say yes for the output xform here; CIccXformNamedColor's override must
  // say no because the source side isn't actually PCS.
  check(!pOutXform->NeedsSrcPcsAdjust(),
        "named color: source side is not a PCS, override overrides the base yes");
  // Symmetric on the destination side for the input xform (base:
  // m_bAdjustPCS && m_bInput).
  check(!pInXform->NeedsDstPcsAdjust(),
        "named color: destination side is not a PCS either");

  delete pOutXform;
  delete pInXform;
}

// Pins the *composition* of the override, not a reachable production chain.
//
// The spectral term (!IsSpaceSpectralPCS(...)) only differs from a bare
// IsSrcPCS()/IsDestPCS() check when the side actually *is* a PCS, just a
// spectral one. That combination is reachable only through the m_pArray
// path: IsSrcPCS()/IsDestPCS() are IsSpacePCS(m_nSrcSpace/m_nDestSpace)
// there (IccCmm.cpp:7944-7975), which is true for a spectral signature
// regardless of what any specific array is configured with. On the m_pTag
// path IsSrcPCS()/IsDestPCS() are signature equality against the tag's own
// GetPCS(), and a CIccTagNamedColor2's PCS cannot legally be spectral --
// CIccXform::Create() always sets it from the profile's m_Header.pcs, and
// CIccProfile rejects a spectral m_Header.pcs for any non-DeviceLink
// profile. (An earlier version of this test forced the tag's PCS to a
// spectral signature directly via SetColorSpaces(), bypassing that
// rejection -- that passed, but only by putting the object in a state the
// library itself can never construct, so it was not real coverage.)
//
// Building a fully populated CIccArrayNamedColor (a tag-array profile with
// named-colour structs and spectral members) just to reach the array path
// honestly is out of proportion to what is being pinned here. This test
// double instead gives CIccXformNamedColor a real, but empty and never
// Begin()'d, CIccArrayNamedColor -- enough for the *real*, unmodified
// IsSrcPCS()/IsDestPCS() to route through the array branch, since that
// branch only null-checks m_pArray and never reads its contents.
// IsSrcPCS()/IsDestPCS() are not virtual, so overriding them in a
// subclass (as first proposed) would not affect NeedsSrcPcsAdjust()'s
// call to them -- that call resolves statically to
// CIccXformNamedColor::IsSrcPCS() regardless of the dynamic type, since
// non-virtual calls from within a base class member function are bound at
// compile time, not through the vtable. Begin() *is* virtual, so it is
// overridden here to skip CIccXformNamedColor::Begin()'s array tail (which
// would call the synthetic array's own Begin() and dereference a null tag
// array); everything NeedsSrcPcsAdjust()/NeedsDstPcsAdjust() depend on
// (m_bAdjustPCS, m_bInput) is set by the inherited CIccXform::Begin() alone.
class SpectralSideNamedColor : public CIccXformNamedColor
{
public:
  SpectralSideNamedColor() : CIccXformNamedColor(NULL, icSigLabData, icSigCmykData)
  {
    m_pArray = new CIccArrayNamedColor();
  }
  virtual ~SpectralSideNamedColor() { delete m_pArray; m_pArray = NULL; }

  virtual icStatusCMM Begin() { return CIccXform::Begin(); }
};

static void namedColorAdjustPredicatesExcludeSpectralPcs()
{
  SpectralSideNamedColor outDouble;
  SpectralSideNamedColor inDouble;

  CIccProfile *pOutProfile = new CIccProfile();
  buildV2CmykOutputProfile(*pOutProfile);
  CIccProfile *pInProfile = new CIccProfile();
  buildV2CmykOutputProfile(*pInProfile);

  // Mirrors what CIccXform::Create() does for a real xform (profile,
  // direction, intent); each double takes ownership of its profile, same
  // as a normally created xform would.
  outDouble.SetParams(pOutProfile, /*bInput=*/false, icPerceptual, icPerceptual,
                       false, icInterpTetrahedral);
  inDouble.SetParams(pInProfile,  /*bInput=*/true,  icPerceptual, icPerceptual,
                      false, icInterpTetrahedral);

  // m_pArray is set, so SetSrcSpace()/SetDestSpace() accept the spectral
  // signature as-is (IccCmm.cpp:7880-7935: the PCS/device/named validation
  // there applies only to the m_pTag case).
  outDouble.SetSrcSpace(icSigReflectanceSpectralPcsData);
  outDouble.SetDestSpace(icSigCmykData);
  inDouble.SetSrcSpace(icSigCmykData);
  inDouble.SetDestSpace(icSigReflectanceSpectralPcsData);

  check(outDouble.Begin() == icCmmStatOk, "named color spectral: output-side Begin");
  check(inDouble.Begin() == icCmmStatOk, "named color spectral: input-side Begin");

  check(outDouble.NeedAdjustPCS(), "named color spectral: v2 perceptual output needs an adjust (base)");
  check(inDouble.NeedAdjustPCS(), "named color spectral: v2 perceptual input needs an adjust (base)");

  // The PCS term alone would pass: IsSrcPCS()/IsDestPCS() report true for
  // the spectral signature via the real m_pArray-path formula. This is
  // what pairs the case, per the coordinator's requirement: without this,
  // the case below would not distinguish the spectral term from the PCS
  // term.
  check(outDouble.IsSrcPCS(), "named color spectral: source side is reported as PCS");
  check(inDouble.IsDestPCS(), "named color spectral: destination side is reported as PCS");

  // Only the !IsSpaceSpectralPCS(...) term can make these false now.
  check(!outDouble.NeedsSrcPcsAdjust(),
        "named color spectral: spectral PCS source excluded from adjustment");
  check(!inDouble.NeedsDstPcsAdjust(),
        "named color spectral: spectral PCS destination excluded from adjustment");
}

int main(int /*argc*/, char ** /*argv*/)
{
  adjustmentIsLargerThanTheToleranceBand();

  trailingEdgeAdjustmentApplies(icPerceptual,
      "trailing edge: v2 perceptual result differs from the unadjusted reference");
  trailingEdgeAdjustmentApplies(icAbsoluteColorimetric,
      "trailing edge: absolute result differs from the unadjusted reference");
  relativeIntentTakesNoAdjustment();

  interiorAdjustmentsCancel();
  connectReportsIdentityWhenAdjustmentsCancel();

  perSideAdjustPredicatesFollowDirection();
  perSideAdjustPredicatesAreOffWhenNothingToAdjust();
  namedColorAdjustPredicatesRequireAnActualPcsSide();
  namedColorAdjustPredicatesExcludeSpectralPcs();

  if (g_failures) {
    std::printf("\n%d check(s) failed\n", g_failures);
    return 1;
  }
  std::printf("\nall checks passed\n");
  return 0;
}
